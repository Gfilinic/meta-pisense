## build/conf/bblayers.conf
```bitbake
# POKY_BBLAYERS_CONF_VERSION is increased each time build/conf/bblayers.conf
# changes incompatibly
POKY_BBLAYERS_CONF_VERSION = "2"

BBPATH = "${TOPDIR}"
BBFILES ?= ""

BBLAYERS ?= " \
  ${TOPDIR}/../sources/meta-openembedded/meta-oe \
  ${TOPDIR}/../sources/meta-openembedded/meta-python \
  ${TOPDIR}/../sources/poky/meta \
  ${TOPDIR}/../sources/poky/meta-poky \
  ${TOPDIR}/../sources/meta-qt6 \
  ${TOPDIR}/../sources/meta-pisense \
  ${TOPDIR}/../sources/meta-raspberrypi \
  "
```

## sources/meta-hupitp/conf/layer.conf
```bitbake
# We have a conf and classes directory, add to BBPATH

BBPATH .= ":${LAYERDIR}"

# We have a packages directory, add to BBFILES

BBFILES += "${LAYERDIR}/recipes-*/*/*.bb "

BBFILE_COLLECTIONS += "hupitp"

BBFILE_PATTERN_hupitp := "^${LAYERDIR}/"

BBFILE_PRIORITY_hupitp = "6"

LAYERSERIES_COMPAT_hupitp = "nanbield"
```

## sources/meta-pisense/conf/layer.conf
```bitbake
# We have a conf and classes directory, add to BBPATH
BBPATH .= ":${LAYERDIR}"

# We have a packages directory, add to BBFILES
BBFILES += "${LAYERDIR}/recipes-*/*/*.bb \
	    ${LAYERDIR}/recipes-*/*/*.bbappend"

BBFILE_COLLECTIONS += "pisense"

BBFILE_PATTERN_pisense = "^${LAYERDIR}/"

BBFILE_PRIORITY_pisense = "6"

LAYERSERIES_COMPAT_pisense = "nanbield"
```
